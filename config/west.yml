## config/west.yml
```yaml
manifest:
  remotes:
    - name: zmkfirmware
      url-base: https://github.com/zmkfirmware
    - name: alansaul
      url-base: https://github.com/alansaul
  projects:
    - name: zmk
      remote: alansaul
      revision: debug/split_connection
      import: app/west.yml
  self:
    path: config
```
